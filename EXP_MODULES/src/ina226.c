#include "system.h"
#include "vl53lxx_i2c_hw.h"
#include "ina226.h"
#include "vl53l1_api.h"
#include "i2cdev.h"
#include "math.h"
#include "FreeRTOS.h"
#include "semphr.h"
#include "task.h"
/*
    不确定具体电阻大射1�7
*/
INA226 INA226_data;
static float SOC = 1;
static float U1 = 0, U2 = 0;
static float dt = 0.1; //间隔时间，后面需要调敄1�7
static float Q_est = 0.133;
//以分段列表的形式写入拟合结果，从0.1-0.99分成90殄1�7
float USeg[90] = {3.6985, 3.7018, 3.7051, 3.7085, 3.7119, 3.7154, 3.7189, 3.7224, 3.726, 3.7296, 3.7333, 3.7369, 3.7407,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 4.2523, 4.2651};
float SSeg[90] = {0.1, 0.11, 0.12, 0.13, 0.14, 0.15, 0.16, 0.17, 0.18, 0.19, 0.2, 0.21, 0.22,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 0.98, 0.99};
float R1Seg[90] = {0.021872, 0.040934, 0.023881, 0.01873, 0.03573, 0.029658, 0.014023, 0.025463, 0.038367, 0.033305, 0.044102, 0.066855, 0.054383,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 0.042499, 0.03574};
float R2Seg[90] = {0.084712, 0.063877, 0.081241, 0.091496, 0.082209, 0.09191, 0.10764, 0.096767, 0.08457, 0.089536, 0.078482, 0.056847, 0.073454,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 0.042733, 0.084175};
float C1Seg[90] = {317.86, 353.28, 201.03, 103.25, 218.86, 527.11, 736.74, 542.28, 286.29, 285.66, 378.75, 436.32, 445.46,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 518.26, 415.18};
float C2Seg[90] = {48.764, 60.813, 83.629, 81.174, 51.33, 26.088, 19.607, 29.997, 34.974, 27.973, 48.813, 84.289, 65.586,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 105.38, 12.235};
float R0Seg[90] = {0.18341, 0.18296, 0.18329, 0.18482, 0.18616, 0.18433, 0.18202, 0.18371, 0.18637, 0.18695, 0.18721, 0.18789, 0.18805,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 0.21373, 0.21378};
float *Coe;
u8 key, len;
u16 iSOCtest = 0, ID, Itemp, calibrated, configuration;
bool right = true;
float voltage, s_cur, s_vol, powerval, bus_cur;
float SOC_temp;
float R1SOC, R2SOC, C1SOC, C2SOC, R0SOC, USOC;
float Ureal;
extern uint8_t ina226config[4] = {0xDF, 0x44, 0x0A, 0x00};
void INA226_Init(void)
{
    //vl53_HWIIC_Init();
    //delay_us(10);
    i2cdevWrite(I2C1_DEV, INA226_ADDR1, CFG_REG, 2, &ina226config[0]);
    i2cdevWrite(I2C1_DEV, INA226_ADDR1, CAL_REG, 2, &ina226config[2]);
}

void INA226_GET_ALL(u8 addr)
{

}
void ina226Task(void *arg)
{
    u32 lastWakeTime = getSysTickCnt();
    INA226_Init();
    ID = INA226_Get_ID(INA226_ADDR1);
    calibrated = INA226_GET_CAL_REG(INA226_ADDR1);
    configuration = INA226_Get_CFG_REG(INA226_ADDR1);
    while (1)
    {
        vTaskDelayUntil(&lastWakeTime, 10); // 10ms周期延时
        i2cdevWrite(I2C1_DEV, INA226_ADDR1, CAL_REG, 2, &ina226config[2]);
        GetPower();
        s_cur = INA226_data.Shunt_Current;
        Coe = findCoe(SOC);
        USOC = Coe[0];
        R0SOC = Coe[1];
        R1SOC = Coe[2];
        C1SOC = Coe[3];
        R2SOC = Coe[4];
        C2SOC = Coe[5];
        if (s_cur == 0)
        {
            SOC = findSOC(voltage);
        }
        SOC = SOC - 0.01f * s_cur * dt / (3600 * Q_est);

        U1 = U1 * (float)(exp((double)(-dt / (R1SOC * C1SOC)))) + s_cur * R1SOC * (1 - (float)(exp((double)(-dt / (R1SOC * C1SOC)))));
        U2 = U2 * (float)(exp((double)(-dt / (R2SOC * C2SOC)))) + s_cur * R2SOC * (1 - (float)(exp((double)(-dt / (R2SOC * C2SOC)))));
        Ureal = voltage + bus_cur * R0SOC + U1 + U2;
        if (findSOC(Ureal / 1000) < 0.9f)
        {
            right = false;
        }
        // tick++;
        // vTaskDelayUntil(&xLastWakeTime, 50);
    }
}
void getPower(float *p)
{
    *p = powerval;
}
void getSOC(float *soc)
{
    *soc = SOC;
}
// void getvoltage(float *v)
// {
//     *v = s_vol;
// }
// void getcurrent(float *c)
// {
//     *c = s_cur;
// }
float findSOC(float U)
{
    int i = 0;
    float s = 0.1;
    for (i = 0; i < 88; i++)
    {
        if (U > USeg[i] && U <= USeg[i + 1])
            break;
    }
    s = SSeg[i];
    return s;
}
float *findCoe(float S)
{
    float a[6] = {USeg[0], R0Seg[0], R1Seg[0], C1Seg[0], R2Seg[0], C2Seg[0]};
    int i = 0;
    for (i = 0; i < 88; i++)
    {
        if (S > SSeg[i] && S <= SSeg[i + 1])
            break;
    }
    a[0] = USeg[i];
    a[1] = R0Seg[i];
    a[2] = R1Seg[i];
    a[3] = C1Seg[i];
    a[4] = R2Seg[i];
    a[5] = C2Seg[i];
    return a;
}

// 1mA/bit
u16 INA226_Get_CFG_REG(u8 addr)
{
    u8 temp[2];
    u16 ans = 0;
    i2cdevRead(I2C1_DEV, addr, CFG_REG, 2, temp);
    ans = (u16)(temp[0]);
    ans = (ans << 8) | temp[1];
    return ans;
}
u16 INA226_GetShunt_Current(u8 addr)
{
    u8 temp[2];
    u16 ans = 0;
    i2cdevRead(I2C1_DEV, addr, CUR_REG, 2, temp);
    ans = (u16)(temp[0]);
    ans = (ans << 8) | temp[1];
    return ans;
}

//获取 id
u16 INA226_Get_ID(u8 addr)
{
    u8 temp[2];
    u16 ans = 0;
    i2cdevRead(I2C1_DEV, addr, INA226_GET_ADDR, 2, temp);
    //    ans = ((*temp)<<8)+*(temp+1);
    ans = (u16)(*temp);
    ans = (ans << 8) | (*(temp + 1));
    return ans;
}

//获取校准倄1�71ￄ1�77
u16 INA226_GET_CAL_REG(u8 addr)
{

    u8 temp[2];
    u16 ans = 0;
    i2cdevRead(I2C1_DEV, addr, CAL_REG, 2, temp);
    ans = (temp[0] << 8) + *(temp + 1);
    return ans;
}

// 1.25mV/bit
u16 INA226_GetVoltage(u8 addr)
{
    u8 temp[2];
    u16 ans = 0;
    i2cdevRead(I2C1_DEV, addr, BV_REG, 2, &temp[0]);
    ans = (temp[0] << 8) + (temp[1]);
    return ans;
}

// 2.5uV/bit,感觉这个值是测不准的，所以下面改戄1�71ￄ1�772.2亄1�71ￄ1�77
u16 INA226_GetShuntVoltage(u8 addr)
{
    u8 temp[2];
    u16 ans = 0;
    i2cdevRead(I2C1_DEV, addr, SV_REG, 2, &temp[0]);
    ans = (temp[0] << 8) | (temp[1]);
    return ans;
}

u16 INA226_Get_Power(u8 addr)
{
    u8 temp[2];
    u16 ans = 0;
    i2cdevRead(I2C1_DEV, addr, PWR_REG, 2, temp);
    ans = (temp[0] << 8) + (temp[1]);
    return ans;
}

void GetVoltage(float *Voltage) // mV
{
    Voltage[0] = INA226_GetVoltage(INA226_ADDR1) * 1.25f;
}

void Get_Shunt_voltage(float *Voltage) // uV
{
    Voltage[0] = (INA226_GetShuntVoltage(INA226_ADDR1) * 2.2); //这里原来乘的系数昄1�71ￄ1�772.5
}

void Get_Shunt_Current(float *Current) // mA
{
    Current[0] = (INA226_GetShunt_Current(INA226_ADDR1) * 2.5f);
}
void Get_Power(float *Current) // W
{
    Current[0] = (INA226_Get_Power(INA226_ADDR1) * 50);
}

void GetPower() // W
{
    GetVoltage(&INA226_data.voltageVal);           // mV
    Get_Shunt_voltage(&INA226_data.Shunt_voltage); // uV
    Get_Shunt_Current(&INA226_data.Shunt_Current); // mA
    INA226_data.powerVal = INA226_data.voltageVal*0.001f*INA226_data.Shunt_Current*0.001f;//mW
}

